#include "net/web.h"
#include "config.h"
#include "core/approval.h"
#include "core/log.h"
#include "core/settings.h"
#include "crypto/crypto.h"
#include "fido/credentials.h"
#include "net/network.h"
#include "net/portal.h"
#include "net/telegram.h"
#include "net/web_page.h"
#include "web_page_gz.h"      // generated by scripts/web_page_gz.py
#include "net/wol.h"
#include "totp/totp.h"
#include "transport/ble.h"
#include "transport/hybrid.h"
#include "ui/ui.h"
#include "util/codec.h"

#include <ESPmDNS.h>
#include <esp_ota_ops.h>
#include <esp_task_wdt.h>
#include <WebServer.h>
#include <WiFi.h>

namespace web {

#define WEB_SESSIONS        4
#define WEB_SESSION_MS      (12UL * 3600UL * 1000UL)

struct Session {
    char     token[33];
    uint32_t ip;
    uint32_t createdMs;
    bool     used;
};

static WebServer s_http(80);
static bool      s_started = false;
static Session   s_sessions[WEB_SESSIONS];

// One "allow this browser?" request at a time.
static struct {
    uint32_t id;
    uint32_t ip;
    uint8_t  state;      // 0 none, 1 waiting, 2 allowed, 3 denied
    int      slot;       // session created on approval
} s_pend;

// --- Helpers -------------------------------------------------------------------

static uint32_t clientIp() { return (uint32_t)s_http.client().remoteIP(); }

static void jstr(String& o, const char* s) {
    o += '"';
    for (; *s; s++) {
        unsigned char c = (unsigned char)*s;
        if (c == '"' || c == '\\') { o += '\\'; o += (char)c; }
        else if (c < 0x20) { char b[8]; snprintf(b, sizeof(b), "\\u%04x", c); o += b; }
        else o += (char)c;
    }
    o += '"';
}

static void sendJson(int code, const String& body) {
    s_http.sendHeader("Cache-Control", "no-store");
    if (body.length() <= 1024) { s_http.send(code, "application/json", body); return; }
    // Long lists (event log, passkeys): in pieces, see sendBody().
    s_http.setContentLength(body.length());
    s_http.send(code, "application/json", "");
    for (size_t off = 0; off < body.length() && s_http.client().connected(); off += 1024) {
        size_t n = body.length() - off < 1024 ? body.length() - off : 1024;
        s_http.sendContent(body.c_str() + off, n);
    }
}

static void sendError(int code, const char* msg) {
    String o = "{\"error\":";
    jstr(o, msg);
    o += '}';
    sendJson(code, o);
}

static int findSession() {
    String cookie = s_http.header("Cookie");
    int at = cookie.indexOf("ak=");
    if (at < 0) return -1;
    String tok = cookie.substring(at + 3, at + 3 + 32);
    if (tok.length() != 32) return -1;
    uint32_t ip = clientIp();
    for (int i = 0; i < WEB_SESSIONS; i++) {
        Session& s = s_sessions[i];
        if (!s.used) continue;
        if (millis() - s.createdMs > WEB_SESSION_MS) { s.used = false; continue; }
        if (s.ip == ip && crypto::equal((const uint8_t*)s.token, (const uint8_t*)tok.c_str(), 32)) return i;
    }
    return -1;
}

static bool authed() { return findSession() >= 0; }

// Management calls: a session cookie, and for changes the X-AuthKey header.
static bool guard(bool change) {
    if (change && s_http.header("X-AuthKey") != "1") { sendError(403, "missing X-AuthKey header"); return false; }
    if (!authed()) { sendError(401, "locked"); return false; }
    return true;
}

static int newSession(uint32_t ip) {
    int slot = 0;
    for (int i = 0; i < WEB_SESSIONS; i++) {
        if (!s_sessions[i].used) { slot = i; break; }
        if (s_sessions[i].createdMs < s_sessions[slot].createdMs) slot = i;   // replace the oldest
    }
    uint8_t raw[16];
    crypto::random(raw, sizeof(raw));
    hexEncode(raw, sizeof(raw), s_sessions[slot].token);
    crypto::wipe(raw, sizeof(raw));
    s_sessions[slot].ip = ip;
    s_sessions[slot].createdMs = millis();
    s_sessions[slot].used = true;
    return slot;
}

// --- Handlers ------------------------------------------------------------------

// Large bodies go out in 1 KB pieces. One big write needs the network stack
// to buffer all of it, which fails (EAGAIN for 8 s, stalling the whole loop)
// while the Telegram TLS session holds most of the RAM.
static void sendBody(const uint8_t* p, size_t n) {
    for (size_t off = 0; off < n && s_http.client().connected(); off += 1024) {
        s_http.sendContent((const char*)p + off, n - off < 1024 ? n - off : 1024);
        esp_task_wdt_reset();
    }
}

static void handlePage() {
    bool gz = s_http.header("Accept-Encoding").indexOf("gzip") >= 0;   // every browser
    const uint8_t* body = gz ? WEB_PAGE_GZ : (const uint8_t*)WEB_PAGE;
    size_t len = gz ? WEB_PAGE_GZ_LEN : strlen(WEB_PAGE);
    s_http.sendHeader("Cache-Control", "no-store");
    if (gz) s_http.sendHeader("Content-Encoding", "gzip");
    s_http.setContentLength(len);
    s_http.send(200, "text/html; charset=utf-8", "");
    sendBody(body, len);
}

static void handleStatus() {
    bool auth = authed();
    char clock[8];
    network::localClock(clock, sizeof(clock));
    String o;
    o.reserve(700);
    o += "{\"fw\":";              jstr(o, FW_VERSION);
    o += ",\"uptime\":";          o += millis() / 1000;
    o += ",\"heap\":";            o += ESP.getFreeHeap();
    o += ",\"clock\":";           jstr(o, clock);
    o += ",\"auth\":";            o += auth ? "true" : "false";
    o += ",\"wifi\":{\"ssid\":";  jstr(o, network::ssid());
    o += ",\"ip\":";              jstr(o, network::ip().c_str());
    o += ",\"rssi\":";            o += network::connected() ? WiFi.RSSI() : 0;
    o += "},\"campus\":{\"have\":"; o += portal::haveCredentials() ? "true" : "false";
    o += ",\"state\":";           jstr(o, portal::stateStr());
    o += ",\"online\":";          o += portal::online() ? "true" : "false";
    o += ",\"paused\":";          o += portal::paused() ? "true" : "false";
    o += ",\"auto\":";            o += portal::enabled() ? "true" : "false";
    o += ",\"owns\":";            o += portal::ownsSession() ? "true" : "false";
    o += ",\"next\":";            o += portal::secondsToNext();
    o += ",\"logins\":";          o += portal::logins();
    o += ",\"refreshes\":";       o += portal::keepalives();
    o += ",\"last\":";            jstr(o, portal::lastResult());
    if (auth) { o += ",\"user\":"; jstr(o, portal::user()); }
    o += "},\"bt\":{\"links\":";  o += ble::linkCount();
    o += ",\"bonds\":";           o += ble::bondCount();
    o += ",\"keyboard\":";        o += ble::keyboardEnabled() ? "true" : "false";
    o += ",\"keyboardHosts\":";   o += ble::keyboardHosts();
    o += "},\"totp\":";           o += totp::count();
    o += ",\"passkeys\":";        o += creds::residentCount();
    o += ",\"passkeyCapacity\":"; o += creds::residentCapacity();
    o += ",\"servers\":";        o += wol::count();
    o += ",\"wol\":";            o += wol::enabled() ? "true" : "false";
    o += ",\"hybrid\":";          jstr(o, hybrid::state() == hybrid::State::Idle ? "" : hybrid::stateText());
    o += '}';
    sendJson(200, o);
}

static void onWebApproval(bool approved, void*) {
    if (s_pend.state != 1) return;
    if (approved) {
        s_pend.slot = newSession(s_pend.ip);
        s_pend.state = 2;
        logEvent("Web access allowed");
    } else {
        s_pend.state = 3;
    }
}

// POST /api/session: ask on the device. GET /api/session?id=N: poll; once
// allowed, the response sets the session cookie.
static void handleSessionStart() {
    if (s_http.header("X-AuthKey") != "1") { sendError(403, "missing X-AuthKey header"); return; }
    uint32_t ip = clientIp();
    if (!(s_pend.state == 1 && s_pend.ip == ip)) {
        char who[24];
        snprintf(who, sizeof(who), "from %s", IPAddress(ip).toString().c_str());
        if (!approval::ask("ALLOW WEB ACCESS?", who, "this browser, 12 hours", false, onWebApproval, nullptr)) {
            sendError(409, "the device is busy; try again");
            return;
        }
        crypto::random((uint8_t*)&s_pend.id, sizeof(s_pend.id));
        s_pend.id &= 0x7FFFFFFF;
        s_pend.ip = ip;
        s_pend.state = 1;
    }
    sendJson(200, String("{\"id\":") + s_pend.id + "}");
}

static void handleSessionPoll() {
    uint32_t id = (uint32_t)strtoul(s_http.arg("id").c_str(), nullptr, 10);
    if (s_pend.state == 0 || id != s_pend.id || clientIp() != s_pend.ip) { sendJson(200, "{\"state\":\"expired\"}"); return; }
    if (s_pend.state == 1) {
        sendJson(200, approval::pending() ? "{\"state\":\"waiting\"}" : "{\"state\":\"expired\"}");
        if (!approval::pending()) s_pend.state = 0;
        return;
    }
    if (s_pend.state == 2) {
        String c = String("ak=") + s_sessions[s_pend.slot].token + "; Path=/; Max-Age=43200; HttpOnly; SameSite=Strict";
        s_http.sendHeader("Set-Cookie", c);
        sendJson(200, "{\"state\":\"allowed\"}");
    } else {
        sendJson(200, "{\"state\":\"denied\"}");
    }
    s_pend.state = 0;
}

static void handleLogout() {
    if (s_http.header("X-AuthKey") != "1") { sendError(403, "missing X-AuthKey header"); return; }
    int i = findSession();
    if (i >= 0) s_sessions[i].used = false;
    s_http.sendHeader("Set-Cookie", "ak=; Path=/; Max-Age=0");
    sendJson(200, "{\"ok\":true}");
}

static void handleLog() {
    if (!guard(false)) return;
    String o = "{\"lines\":[";
    for (int i = 0; i < logCount(); i++) {
        if (i) o += ',';
        jstr(o, logLine(i));
    }
    o += "]}";
    sendJson(200, o);
}

static void handlePortal() {
    if (!guard(true)) return;
    String what = s_http.arg("do");
    if (!portal::haveCredentials()) { sendError(400, "no IITG credentials in .env"); return; }
    if (what == "login") portal::loginNow();
    else if (what == "logout") portal::logout();
    else if (what == "on" || what == "off") portal::setEnabled(what == "on");
    else { sendError(400, "do=login|logout|on|off"); return; }
    sendJson(200, "{\"ok\":true}");
}

static void handleTotpList() {
    if (!guard(false)) return;
    String o = "{\"accounts\":[";
    TotpAccount a;
    for (int i = 0; i < totp::count(); i++) {
        if (!totp::get(i, &a)) continue;
        if (i) o += ',';
        o += "{\"i\":"; o += i;
        o += ",\"name\":"; jstr(o, a.name);
        o += ",\"digits\":"; o += a.digits;
        o += ",\"period\":"; o += a.period;
        o += ",\"algo\":"; o += a.algo;
        o += '}';
    }
    crypto::wipe(&a, sizeof(a));
    o += "]}";
    sendJson(200, o);
}

static void handleTotpAdd() {
    if (!guard(true)) return;
    String uri = s_http.arg("plain");
    uri.trim();
    TotpAccount a;
    bool ok = totp::parseUri(uri.c_str(), &a);
    int i = ok ? totp::add(a) : -1;
    crypto::wipe(&a, sizeof(a));
    for (size_t k = 0; k < uri.length(); k++) uri[k] = 0;   // held the secret
    if (!ok) { sendError(400, "not a valid otpauth://totp/ link"); return; }
    if (i < 0) { sendError(507, "TOTP storage full"); return; }
    logEvent("TOTP added (web)");
    sendJson(200, String("{\"ok\":true,\"i\":") + i + "}");
}

static void handleTotpDelete() {
    if (!guard(true)) return;
    if (!totp::remove(s_http.arg("i").toInt())) { sendError(404, "no such account"); return; }
    logEvent("TOTP deleted (web)");
    sendJson(200, "{\"ok\":true}");
}

static void handlePasskeyList() {
    if (!guard(false)) return;
    String o = "{\"passkeys\":[";
    ResidentCredential c;
    bool first = true;
    for (int i = 0; i < creds::residentCapacity(); i++) {
        if (!creds::residentGet(i, &c)) continue;
        if (!first) o += ',';
        first = false;
        o += "{\"slot\":"; o += i;
        o += ",\"rp\":"; jstr(o, c.rpId);
        o += ",\"user\":"; jstr(o, c.userName);
        o += ",\"display\":"; jstr(o, c.displayName);
        o += ",\"order\":"; o += c.created;
        o += '}';
    }
    o += "]}";
    sendJson(200, o);
}

static void handlePasskeyDelete() {
    if (!guard(true)) return;
    if (!creds::residentDelete(s_http.arg("slot").toInt())) { sendError(404, "no such passkey"); return; }
    logEvent("Passkey deleted (web)");
    sendJson(200, "{\"ok\":true}");
}

static void handleHybrid() {
    if (!guard(true)) return;
    String qr = s_http.arg("plain");
    qr.trim();
    if (qr == "stop") { hybrid::stop("stopped from web"); sendJson(200, "{\"ok\":true}"); return; }
    if (!hybrid::start(qr.c_str())) { sendError(400, "not a passkey QR (FIDO:/...)"); return; }
    sendJson(200, "{\"ok\":true}");
}

// --- Wake-on-LAN machines ---------------------------------------------------------------

static void handleHosts() {
    if (!guard(false)) return;
    String o = "{\"enabled\":";
    o += wol::enabled() ? "true" : "false";
    o += ",\"hosts\":[";
    char mac[18];
    for (int i = 0; i < wol::count(); i++) {
        const wol::Host* h = wol::host(i);
        wol::formatMac(h->mac, mac, sizeof(mac));
        if (i) o += ',';
        o += "{\"i\":"; o += i;
        o += ",\"name\":"; jstr(o, h->name);
        o += ",\"mac\":"; jstr(o, mac);
        o += ",\"ip\":"; jstr(o, h->ip);
        o += ",\"ports\":\""; o += h->ports[0]; if (h->ports[1]) { o += ','; o += h->ports[1]; } o += '"';
        o += ",\"broadcast\":"; jstr(o, h->broadcast);
        o += ",\"state\":"; o += wol::lastState(i);
        o += ",\"waking\":"; o += wol::waking(i) ? "true" : "false";
        uint32_t age = wol::lastCheckAgeS(i);
        o += ",\"age\":"; o += age == UINT32_MAX ? -1 : (long)age;
        o += ",\"auto\":"; o += h->autoWake ? "true" : "false";
        o += ",\"autoMin\":"; o += h->autoMin;
        o += ",\"alerts\":"; o += h->alerts ? "true" : "false";
        o += ",\"paused\":"; o += wol::paused(i) ? "true" : "false";
        o += ",\"pausedUntil\":"; o += h->pausedUntil == WOL_PAUSE_UNTIL_UP ? -1L : (long)h->pausedUntil;
        o += ",\"maint\":[";
        char w[40];
        bool first = true;
        for (const wol::Window& win : h->maint) {
            if (!win.days) continue;
            wol::formatWindow(win, w, sizeof(w));
            if (!first) o += ',';
            first = false;
            jstr(o, w);
        }
        o += "],\"inMaint\":"; o += wol::inMaintenance(i) ? "true" : "false";
        o += ",\"maintWake\":"; o += h->maintWake ? "true" : "false";
        o += '}';
    }
    o += "]}";
    sendJson(200, o);
}

static int hostParam() {
    int i = s_http.arg("i").toInt();
    if (s_http.arg("i").length() == 0 || !wol::host(i)) { sendError(404, "no such machine"); return -1; }
    return i;
}

static void handleHostWake() {
    if (!guard(true)) return;
    int i = hostParam();
    if (i < 0) return;
    if (!wol::wake(i, "web")) { sendError(409, "wake-on-LAN is off"); return; }
    sendJson(200, "{\"ok\":true}");
}

static void handleHostCheck() {
    if (!guard(true)) return;
    int i = hostParam();
    if (i < 0) return;
    uint16_t port;
    uint32_t ms = 0;
    bool up = wol::check(i, &port, &ms);
    sendJson(200, String("{\"up\":") + (up ? "true" : "false") + ",\"port\":" + port + ",\"ms\":" + ms + "}");
}

static void handleHostAuto() {
    if (!guard(true)) return;
    int i = hostParam();
    if (i < 0) return;
    wol::setAutoWake(i, s_http.arg("on") == "1", s_http.arg("min").toInt());
    sendJson(200, "{\"ok\":true}");
}

static void handleHostAlerts() {
    if (!guard(true)) return;
    int i = hostParam();
    if (i < 0) return;
    wol::setAlerts(i, s_http.arg("on") == "1");
    sendJson(200, "{\"ok\":true}");
}

// secs=0 resumes; secs=-1 pauses until the machine is seen up.
static void handleHostPause() {
    if (!guard(true)) return;
    int i = hostParam();
    if (i < 0) return;
    long secs = s_http.arg("secs").toInt();
    if (!wol::pause(i, secs < 0 ? WOL_PAUSE_UNTIL_UP : (uint32_t)secs)) { sendError(409, "the clock isn't set yet"); return; }
    sendJson(200, "{\"ok\":true}");
}

// add=<"sat 00:00 120"> or clear=1
static void handleHostMaint() {
    if (!guard(true)) return;
    int i = hostParam();
    if (i < 0) return;
    char err[64];
    if (s_http.hasArg("clear")) {
        wol::clearWindows(i);
    } else {
        wol::Window w;
        if (!wol::parseWindow(s_http.arg("add").c_str(), &w, err, sizeof(err)) || !wol::addWindow(i, w, err, sizeof(err))) {
            sendError(400, err);
            return;
        }
    }
    logEvent("WoL %s maintenance changed (web)", wol::host(i)->name);
    sendJson(200, "{\"ok\":true}");
}

static void handleHostSave() {
    if (!guard(true)) return;
    wol::Host h;
    char err[64];
    if (!wol::makeHost(s_http.arg("name").c_str(), s_http.arg("mac").c_str(), s_http.arg("ip").c_str(),
                       s_http.arg("ports").c_str(), s_http.arg("broadcast").c_str(), &h, err, sizeof(err))) {
        sendError(400, err);
        return;
    }
    int old = wol::find(h.name);
    if (old >= 0) wol::copySettings(*wol::host(old), &h);
    if (wol::put(h, err, sizeof(err)) < 0) { sendError(507, err); return; }
    logEvent("WoL host %s saved (web)", h.name);
    sendJson(200, "{\"ok\":true}");
}

static void handleHostDelete() {
    if (!guard(true)) return;
    int i = hostParam();
    if (i < 0) return;
    String name = wol::host(i)->name;
    wol::remove(i);
    logEvent("WoL host %s removed (web)", name.c_str());
    sendJson(200, "{\"ok\":true}");
}

static void handleWolSwitch() {
    if (!guard(true)) return;
    wol::setEnabled(s_http.arg("on") == "1");
    logEvent("WoL %s (web)", wol::enabled() ? "on" : "off");
    sendJson(200, "{\"ok\":true}");
}

// --- Firmware update -------------------------------------------------------------------------
//
// POST /api/update (multipart, a session and X-AuthKey): the .bin is written
// to the spare app slot while it arrives and checked (ESP32 image header and
// SHA-256 by esp_ota_end, plus the AuthKey tag below, so a wrong .bin is
// refused). Nothing changes until OK (and the device PIN, if set) is pressed
// on the AuthKey, which shows the new version; only then does the device boot
// the new slot. GET /api/update?id=N polls; GET /api/update shows the
// running version.

// Every AuthKey firmware carries this tag; an upload without it is refused.
// The search pattern is stored XOR-ed so this firmware's own copy of it
// doesn't count as a tag.
#define FW_TAG_PREFIX "AKFW1|"
static const char FW_TAG[] = FW_TAG_PREFIX FW_NAME "|" FW_VERSION "|" __DATE__;
static const uint8_t TAG_X[] = {'A' ^ 0x5A, 'K' ^ 0x5A, 'F' ^ 0x5A, 'W' ^ 0x5A, '1' ^ 0x5A, '|' ^ 0x5A};

static struct {
    uint8_t  state;          // 0 none, 1 receiving, 2 received, 3 waiting for OK, 4 installed, 5 denied, 6 failed
    uint32_t ip, id;
    esp_ota_handle_t handle;
    const esp_partition_t* part;
    size_t   size;
    bool     tagged;
    char     version[16];
    char     err[64];
    uint8_t  tail[40];       // end of the previous chunk (tag across a boundary)
    size_t   tailLen;
    uint32_t rebootAtMs;
} s_up;

static void upFail(const char* why) {
    if (s_up.state == 1) esp_ota_abort(s_up.handle);
    s_up.state = 6;
    strlcpy(s_up.err, why, sizeof(s_up.err));
    logf("WEB", "firmware upload refused: %s", why);
}

// Looks for the tag in tail + chunk; reads the version after "AKFW1|<name>|".
static void scanTag(const uint8_t* p, size_t n) {
    if (s_up.tagged) return;
    uint8_t pat[sizeof(TAG_X)];
    for (size_t k = 0; k < sizeof(pat); k++) pat[k] = TAG_X[k] ^ 0x5A;
    uint8_t buf[sizeof(s_up.tail) + 80];
    // Boundary region first (tail + start of this chunk), then the chunk itself.
    size_t head = n < 80 ? n : 80;
    memcpy(buf, s_up.tail, s_up.tailLen);
    memcpy(buf + s_up.tailLen, p, head);
    const uint8_t* regions[2] = {buf, p};
    size_t lens[2] = {s_up.tailLen + head, n};
    for (int r = 0; r < 2 && !s_up.tagged; r++) {
        const uint8_t* at = regions[r];
        size_t left = lens[r];
        while (left >= sizeof(pat)) {
            const uint8_t* hit = (const uint8_t*)memmem(at, left, pat, sizeof(pat));
            if (!hit) break;
            const char* name = (const char*)hit + sizeof(pat);
            size_t room = regions[r] + lens[r] - (const uint8_t*)name;
            size_t nameLen = strlen(FW_NAME);
            if (room > nameLen + 2 && !memcmp(name, FW_NAME "|", nameLen + 1)) {
                const char* v = name + nameLen + 1;
                size_t vroom = regions[r] + lens[r] - (const uint8_t*)v, k = 0;
                while (k < vroom && k < sizeof(s_up.version) - 1 && v[k] != '|' && v[k] >= ' ') { s_up.version[k] = v[k]; k++; }
                s_up.version[k] = '\0';
                s_up.tagged = true;
                break;
            }
            left -= hit + 1 - at;
            at = hit + 1;
        }
    }
    size_t keep = n < sizeof(s_up.tail) ? n : sizeof(s_up.tail);
    memcpy(s_up.tail, p + n - keep, keep);
    s_up.tailLen = keep;
}

static void handleUpload() {
    HTTPUpload& up = s_http.upload();
    if (up.status == UPLOAD_FILE_START) {
        if (s_up.state == 1) esp_ota_abort(s_up.handle);
        memset(&s_up, 0, sizeof(s_up));
        if (s_http.header("X-AuthKey") != "1" || !authed()) { upFail("locked"); return; }
        if (approval::pending()) { upFail("the device is waiting for another confirmation"); return; }
        s_up.part = esp_ota_get_next_update_partition(nullptr);
        if (!s_up.part || esp_ota_begin(s_up.part, OTA_SIZE_UNKNOWN, &s_up.handle) != ESP_OK) {
            s_up.state = 6;
            strlcpy(s_up.err, "no spare app slot", sizeof(s_up.err));
            return;
        }
        s_up.state = 1;
        s_up.ip = clientIp();
        logEvent("Firmware upload (web)");
        logf("WEB", "firmware upload to %s from %s", s_up.part->label, IPAddress(s_up.ip).toString().c_str());
    } else if (up.status == UPLOAD_FILE_WRITE) {
        if (s_up.state != 1) return;
        if (!s_up.size && up.currentSize && up.buf[0] != 0xE9) { upFail("not an ESP32 firmware .bin"); return; }
        scanTag(up.buf, up.currentSize);
        if (esp_ota_write(s_up.handle, up.buf, up.currentSize) != ESP_OK) { upFail("too big for the app slot, or a flash error"); return; }
        s_up.size += up.currentSize;
        esp_task_wdt_reset();                       // the whole upload runs inside one loop() pass
        int total = s_http.clientContentLength();
        if ((s_up.size & 0xFFFF) < up.currentSize) ui::otaProgress(s_up.size, total > 0 ? total : s_up.size);
    } else if (up.status == UPLOAD_FILE_END) {
        if (s_up.state != 1) return;
        if (!s_up.tagged) { upFail("not AuthKey firmware (tag missing)"); return; }
        esp_err_t e = esp_ota_end(s_up.handle);
        if (e != ESP_OK) {
            s_up.state = 6;
            strlcpy(s_up.err, e == ESP_ERR_OTA_VALIDATE_FAILED ? "image check failed (damaged or incomplete)" : "write failed",
                    sizeof(s_up.err));
            return;
        }
        s_up.state = 2;
        logf("WEB", "firmware v%s received (%u bytes), waiting for OK", s_up.version, (unsigned)s_up.size);
    } else if (up.status == UPLOAD_FILE_ABORTED) {
        upFail("upload interrupted");
    }
}

static void onFirmwareApproval(bool approved, void*) {
    if (s_up.state != 3) return;
    if (!approved) {
        s_up.state = 5;
        logEvent("Firmware v%s denied", s_up.version);
        return;
    }
    if (esp_ota_set_boot_partition(s_up.part) != ESP_OK) {
        s_up.state = 6;
        strlcpy(s_up.err, "couldn't switch to the new slot", sizeof(s_up.err));
        return;
    }
    s_up.state = 4;
    logEvent("Firmware v%s installed (web)", s_up.version);
    s_up.rebootAtMs = (millis() + 3000) | 1;        // time for the browser to hear it
}

static void handleUploadDone() {
    if (!guard(true)) { if (s_up.state == 1) esp_ota_abort(s_up.handle); s_up.state = 0; return; }
    if (s_up.state == 6) { sendError(400, s_up.err); s_up.state = 0; return; }
    if (s_up.state != 2) { sendError(400, "no firmware received"); return; }
    char detail[32];
    snprintf(detail, sizeof(detail), "v%s, %u KB", s_up.version, (unsigned)(s_up.size / 1024));
    if (!approval::ask("INSTALL FIRMWARE?", detail, "uploaded on the web page", true, onFirmwareApproval, nullptr)) {
        sendError(409, "the device is busy; try again");
        s_up.state = 0;
        return;
    }
    crypto::random((uint8_t*)&s_up.id, sizeof(s_up.id));
    s_up.id &= 0x7FFFFFFF;
    s_up.state = 3;
    String o = String("{\"id\":") + s_up.id + ",\"size\":" + s_up.size + ",\"version\":";
    jstr(o, s_up.version);
    sendJson(200, o + "}");
}

static void handleUpdateInfo() {
    if (!guard(false)) return;
    if (s_http.hasArg("id")) {
        uint32_t id = (uint32_t)strtoul(s_http.arg("id").c_str(), nullptr, 10);
        static const char* const NAMES[] = {"none", "receiving", "received", "waiting", "installed", "denied", "failed"};
        const char* st = id == s_up.id && s_up.state < 7 ? NAMES[s_up.state] : "expired";
        if (s_up.state == 3 && !approval::pending()) st = "expired";
        String o = "{\"state\":";
        jstr(o, st);
        o += ",\"error\":";
        jstr(o, s_up.state == 6 ? s_up.err : "");
        sendJson(200, o + "}");
        return;
    }
    const esp_partition_t* run = esp_ota_get_running_partition();
    const esp_partition_t* next = esp_ota_get_next_update_partition(nullptr);
    String o = "{\"version\":";
    jstr(o, FW_VERSION);
    o += ",\"build\":";
    jstr(o, FW_TAG + sizeof(FW_TAG_PREFIX) - 1 + strlen(FW_NAME) + 1);
    o += ",\"running\":";
    jstr(o, run ? run->label : "?");
    o += ",\"slot\":";
    o += next ? next->size : 0;
    sendJson(200, o + "}");
}

// --- Remote access ------------------------------------------------------------------------

static void handleRemote() {
    if (!guard(false)) return;
    String o = "{\"telegram\":";
    jstr(o, telegram::stateStr());
    o += ",\"error\":"; jstr(o, telegram::lastError());
    o += ",\"notify\":"; o += telegram::notifyLevel();
    o += ",\"codes\":"; o += telegram::remoteCodes() ? "true" : "false";
    o += '}';
    sendJson(200, o);
}

// Notification level only: "codes over Telegram" can only change on the device.
static void handleRemoteSet() {
    if (!guard(true)) return;
    if (s_http.hasArg("notify")) telegram::setNotifyLevel(s_http.arg("notify").toInt());
    sendJson(200, "{\"ok\":true}");
}

static void start() {
    static bool routes = false;   // handlers are registered once; begin() may run again
    if (!routes) {
        routes = true;
        static const char* headers[] = {"Cookie", "X-AuthKey", "Accept-Encoding"};
        s_http.collectHeaders(headers, 3);
        s_http.on("/", HTTP_GET, handlePage);
        s_http.on("/api/status", HTTP_GET, handleStatus);
        s_http.on("/api/session", HTTP_POST, handleSessionStart);
        s_http.on("/api/session", HTTP_GET, handleSessionPoll);
        s_http.on("/api/logout", HTTP_POST, handleLogout);
        s_http.on("/api/log", HTTP_GET, handleLog);
        s_http.on("/api/portal", HTTP_POST, handlePortal);
        s_http.on("/api/totp", HTTP_GET, handleTotpList);
        s_http.on("/api/totp/add", HTTP_POST, handleTotpAdd);
        s_http.on("/api/totp/delete", HTTP_POST, handleTotpDelete);
        s_http.on("/api/passkeys", HTTP_GET, handlePasskeyList);
        s_http.on("/api/passkeys/delete", HTTP_POST, handlePasskeyDelete);
        s_http.on("/api/hybrid", HTTP_POST, handleHybrid);
        s_http.on("/api/hosts", HTTP_GET, handleHosts);
        s_http.on("/api/hosts/wake", HTTP_POST, handleHostWake);
        s_http.on("/api/hosts/check", HTTP_POST, handleHostCheck);
        s_http.on("/api/hosts/auto", HTTP_POST, handleHostAuto);
        s_http.on("/api/hosts/save", HTTP_POST, handleHostSave);
        s_http.on("/api/hosts/alerts", HTTP_POST, handleHostAlerts);
        s_http.on("/api/hosts/pause", HTTP_POST, handleHostPause);
        s_http.on("/api/hosts/maint", HTTP_POST, handleHostMaint);
        s_http.on("/api/hosts/delete", HTTP_POST, handleHostDelete);
        s_http.on("/api/wol", HTTP_POST, handleWolSwitch);
        s_http.on("/api/remote", HTTP_GET, handleRemote);
        s_http.on("/api/remote", HTTP_POST, handleRemoteSet);
        s_http.on("/api/update", HTTP_GET, handleUpdateInfo);
        s_http.on("/api/update", HTTP_POST, handleUploadDone, handleUpload);
        s_http.onNotFound([]() { sendError(404, "not found"); });
    }
    s_http.begin();
    MDNS.addService("http", "tcp", 80);
    s_started = true;
    logf("WEB", "management page at http://%s/ (authkey-esp32.local), firmware %s", network::ip().c_str(), FW_TAG);
}

void loop() {
    if (s_up.rebootAtMs && (int32_t)(millis() - s_up.rebootAtMs) >= 0) {
        logFlush();
        delay(200);
        ESP.restart();
    }
    if (!settings::webPage()) {
        if (s_started) { s_http.stop(); s_started = false; logf("WEB", "web page off"); }
        return;
    }
    if (!s_started) {
        if (network::connected()) start();
        return;
    }
    s_http.handleClient();
}

}  // namespace web
